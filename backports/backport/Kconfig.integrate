## backports/net/wireless/Kconfig
```kconfig
# Wireless configuration (cfg80211)
# This will be populated by gentree.py from upstream kernel

config CPTCFG_CFG80211
	tristate "cfg80211 - wireless configuration API"
	depends on BACKPORT_LINUX
	select BACKPORT_COMPAT
	help
	  cfg80211 is the Linux wireless LAN (802.11) configuration API.
	  This is backported from Linux v5.10.

	  If you have a wireless device and want to use it, say M here.

if CPTCFG_CFG80211

config CPTCFG_CFG80211_WEXT
	bool "cfg80211 wireless extensions compatibility"
	depends on CPTCFG_CFG80211
	select WIRELESS_EXT
	select WEXT_PRIV
	help
	  Enable this option if you need old userspace for wireless
	  extensions with cfg80211-based drivers.

config CPTCFG_CFG80211_REQUIRE_SIGNED_REGDB
	bool "require regdb signature" if EXPERT
	default y
	depends on CPTCFG_CFG80211
	help
	  Require that in addition to the "regulatory.db" file a
	  "regulatory.db.p7s" can be loaded with a valid PKCS#7
	  signature for the regulatory.db file made by one of the
	  keys in the certs/ directory.

config CPTCFG_CFG80211_USE_KERNEL_REGDB_KEYS
	bool "use statically compiled regulatory rules database" if EXPERT
	default y
	depends on CPTCFG_CFG80211_REQUIRE_SIGNED_REGDB
	help
	  This option should be selected by any module that would like to
	  use statically compiled regulatory rules databases to identify
	  regulatory domains.

config CPTCFG_CFG80211_DEFAULT_PS
	bool "enable powersave by default"
	depends on CPTCFG_CFG80211
	default y
	help
	  This option enables powersave mode by default.

config CPTCFG_CFG80211_DEBUGFS
	bool "cfg80211 DebugFS entries"
	depends on CPTCFG_CFG80211
	depends on DEBUG_FS
	help
	  You can enable this if you want debugfs entries for cfg80211.

config CPTCFG_CFG80211_CRDA_SUPPORT
	bool "support CRDA" if EXPERT
	default y
	depends on CPTCFG_CFG80211
	help
	  You should enable this option unless you know for sure you have no
	  need for it, for example when using internal regdb (above.)

endif # CPTCFG_CFG80211
```
