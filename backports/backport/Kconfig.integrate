## backports/backport/Kconfig.integrate
```kconfig
config BACKPORT_INTEGRATE
	bool
	def_bool y

config BACKPORT_DIR
	string
	default "backports/"

config BACKPORT_VERSION
	string
	default "v5.10"

config BACKPORT_KERNEL_VERSION
	string
	default "5.10.x"

config BACKPORT_KERNEL_NAME
	string
	default "Linux"

menuconfig BACKPORT_LINUX
	bool "Backport Linux 5.10.x (backports v5.10)"
	default n
	---help---
	  Enabling this will let give you the opportunity to use features and
	  drivers backported from Linux 5.10.x
	  on the kernel your are using. This is experimental and you should
	  say no unless you'd like to help test things or want to help debug
	  this should we run into any issues.

if BACKPORT_LINUX

source "backports/backport/Kconfig.versions"
source "backports/backport/Kconfig.sources"
source "backports/backport/Kconfig.local"

endif # BACKPORT_LINUX
```

## backports/drivers/net/usb/Kconfig
```kconfig
# USB Network drivers configuration
# This will be populated by gentree.py from upstream kernel

menuconfig CPTCFG_USB_NET_DRIVERS
	tristate "USB Network Adapters"
	depends on BACKPORT_LINUX
	depends on USB && NET
	default USB if USB
	help
	  This section contains drivers for USB network adapters.

if CPTCFG_USB_NET_DRIVERS

config CPTCFG_USB_USBNET
	tristate "Multi-purpose USB Networking Framework"
	depends on BACKPORT_LINUX
	select BACKPORT_COMPAT
	select MII
	help
	  This driver supports several kinds of network links over USB,
	  with "minidrivers" built around a common network driver core
	  that supports deep queues for efficient transfers.  (This gives
	  better performance with small packets and at high speeds).

	  The USB host runs "usbnet", and the other end of the link might be:

	  - Another USB host, when using USB "network" or "data transfer"
	    cables.  These are often used to network laptops to PCs, like
	    "Laplink" parallel cables or some motherboards.  These rely
	    on specialized chips from many vendors.

	  - An intelligent USB gadget, perhaps embedding a Linux system.
	    These include PDAs running Linux (like the Sharp Zaurus or
	    Yopy), and devices that interoperate using the standard CDC
	    (Communications Device Class) specification.

	  - Network adapter hardware (like those for 10/100 Ethernet) which
	    uses this driver framework.

	  The link will appear with a name like "usb0", when the link is
	  a two-node link, or "eth0" for most CDC-Ethernet devices.  Those
	  two-node links are most easily managed with Ethernet Bridging
	  (CONFIG_BRIDGE) instead of routing.

	  For more information see <http://www.linux-usb.org/usbnet/>.

	  To compile this driver as a module, choose M here: the
	  module will be called usbnet.

config CPTCFG_USB_NET_RNDIS_HOST
	tristate "Host for RNDIS and ActiveSync devices"
	depends on CPTCFG_USB_USBNET
	select BACKPORT_COMPAT
	help
	  This option enables hosting "Remote NDIS" USB networking links,
	  as encouraged by Microsoft (instead of CDC Ethernet!) for use in
	  various devices that may only support this protocol.  A variant
	  of this protocol (with even less public documentation) seems to
	  be at the root of Microsoft's "ActiveSync" too.

	  Avoid using this protocol unless you have no better options.
	  The protocol specification is incomplete, and is controlled by
	  (and for) Microsoft; it isn't an "Open" ecosystem or market.

config CPTCFG_USB_NET_CDC_ETHER
	tristate "CDC Ethernet support (smart devices such as cable modems)"
	depends on CPTCFG_USB_USBNET
	select BACKPORT_COMPAT
	default y
	help
	  This option supports devices conforming to the Communication Device
	  Class (CDC) Ethernet Control Model, a specification that's easy to
	  implement in device firmware.  The CDC specifications are available
	  from <http://www.usb.org/>.

	  CDC Ethernet is an implementation option for DOCSIS cable modems
	  that support USB connectivity, used for non-Microsoft USB hosts.
	  The Linux-USB CDC Ethernet Gadget driver is an open implementation.
	  This driver should work with at least the following devices:

	    * Dell Wireless 5530 HSPA
	    * Ericsson PipeRider (all variants)
	    * Ericsson Mobile Broadband Module (all variants)
	    * Motorola (DM100 and SB4100)
	    * Broadcom Cable Modem (reference design)
	    * Toshiba (PCX1100U and F3507g/F3607gw)
	    * ...

	  This driver creates an interface named "ethX", where X depends on
	  what other networking devices you have in use.  However, if the
	  IEEE 802 "local assignment" bit is set in the address, a "usbX"
	  name is used instead.

config CPTCFG_USB_NET_CDC_MBIM
	tristate "CDC MBIM support"
	depends on CPTCFG_USB_USBNET
	select BACKPORT_COMPAT
	help
	  This driver provides support for CDC MBIM (Mobile Broadband
	  Interface Model) devices. The CDC MBIM specification is
	  available from <http://www.usb.org/>.

	  MBIM devices require configuration using the management
	  protocol defined by the MBIM specification.  This driver
	  provides unfiltered access to the MBIM control channel
	  through the associated /dev/cdc-wdmX character device.

	  To compile this driver as a module, choose M here: the
	  module will be called cdc_mbim.

config CPTCFG_USB_NET_CDC_NCM
	tristate "CDC NCM support"
	depends on CPTCFG_USB_USBNET
	select BACKPORT_COMPAT
	default y
	help
	  This driver provides support for CDC NCM (Network Control Model
	  Device USB Class Specification). The CDC NCM specification is
	  available from <http://www.usb.org/>.

	  Say "y" to link the driver statically, or "m" to build a
	  dynamically linked module.

	  This driver should work with at least the following devices:
	    * ST-Ericsson M700 LTE FDD/TDD Mobile Broadband Modem (ref. design)
	    * ST-Ericsson M5730 HSPA+ Mobile Broadband Modem (reference design)
	    * ST-Ericsson M570 HSPA+ Mobile Broadband Modem (reference design)
	    * Ericsson F5521gw Mobile Broadband Module

config CPTCFG_USB_NET_QMI_WWAN
	tristate "QMI WWAN driver for Qualcomm MSM based 3G and LTE modems"
	depends on CPTCFG_USB_USBNET
	select BACKPORT_COMPAT
	help
	  Support WWAN LTE/3G devices based on Qualcomm Mobile Data Modem
	  (MDM) chipsets.  Examples of such devices are
	    * Huawei E392/E398

	  This driver will only drive the ethernet part of the chips.
	  The devices require additional configuration to be usable.
	  Multiple management interfaces with linux drivers are
	  available:

	    * option: AT commands on /dev/ttyUSBx
	    * cdc-wdm: Qualcomm MSM Interface (QMI) protocol on /dev/cdc-wdmx

	  A modem manager with support for QMI is recommended.

	  To compile this driver as a module, choose M here: the
	  module will be called qmi_wwan.

config CPTCFG_USB_NET_SIERRA_NET
	tristate "Sierra Wireless devices"
	depends on CPTCFG_USB_USBNET
	select BACKPORT_COMPAT
	default y
	help
	  Choose this option if you have a Sierra Wireless USB device.

	  To compile this driver as a module, choose M here: the
	  module will be called sierra_net.

endif # CPTCFG_USB_NET_DRIVERS
```

## backports/drivers/net/wireless/Kconfig
```kconfig
# Wireless LAN drivers configuration
# This will be populated by gentree.py from upstream kernel

menuconfig CPTCFG_WLAN
	bool "Wireless LAN"
	depends on BACKPORT_LINUX
	depends on !S390
	depends on NET
	select WIRELESS
	default y
	help
	  This section contains all the pre 802.11 and 802.11 wireless
	  device drivers. For a complete list of drivers and documentation
	  on them refer to the wireless wiki:

	  http://wireless.kernel.org/en/users/Drivers

if CPTCFG_WLAN

source "backports/drivers/net/wireless/ath/Kconfig"

endif # CPTCFG_WLAN
```

## backports/drivers/net/wireless/ath/Kconfig
```kconfig
# SPDX-License-Identifier: ISC
# Atheros wireless drivers configuration

config CPTCFG_ATH_COMMON
	tristate
	depends on BACKPORT_LINUX

menuconfig CPTCFG_WLAN_VENDOR_ATH
	bool "Atheros/Qualcomm devices"
	depends on CPTCFG_WLAN
	default y
	help
	  If you have a wireless card belonging to this class, say Y.

	  Note that the answer to this question doesn't directly affect the
	  kernel: saying N will just cause the configurator to skip all the
	  questions about these cards. If you say Y, you will be asked for
	  your specific card in the following questions.

	  For more information and documentation on this module you can visit:

	  http://wireless.kernel.org/en/users/Drivers/ath

	  For information on all Atheros wireless drivers visit:

	  http://wireless.kernel.org/en/users/Drivers/Atheros

if CPTCFG_WLAN_VENDOR_ATH

config CPTCFG_ATH_DEBUG
	bool "Atheros wireless debugging"
	depends on CPTCFG_ATH_COMMON
	help
	  Say Y, if you want to debug atheros wireless drivers.
	  Right now only ath9k makes use of this.

config CPTCFG_ATH_TRACEPOINTS
	bool "Atheros wireless tracing"
	depends on CPTCFG_ATH_COMMON
	depends on EVENT_TRACING
	help
	  This option enables tracepoints for atheros wireless drivers.

config CPTCFG_ATH_REG_DYNAMIC_USER_REG_HINTS
	bool "Atheros dynamic user regulatory hints"
	depends on CPTCFG_ATH_COMMON
	depends on CPTCFG_CFG80211_CERTIFICATION_ONUS
	default n
	help
	  Say N. This should only be enabled in countries where
	  this feature is explicitly allowed and only on cards that
	  specifically have been tested for this.

config CPTCFG_ATH_REG_DYNAMIC_USER_CERT_TESTING
	bool "Atheros dynamic user regulatory testing"
	depends on CPTCFG_ATH_COMMON
	depends on CPTCFG_ATH_REG_DYNAMIC_USER_REG_HINTS
	depends on CPTCFG_CFG80211_CERTIFICATION_ONUS
	default n
	help
	  Say N. This should only be enabled on systems
	  undergoing certification testing.

source "backports/drivers/net/wireless/ath/ath11k/Kconfig"

endif # CPTCFG_WLAN_VENDOR_ATH
```

## backports/drivers/net/wireless/ath/ath11k/Kconfig
```kconfig
# SPDX-License-Identifier: BSD-3-Clause-Clear
# ATH11K driver configuration

config CPTCFG_ATH11K
	tristate "Qualcomm Technologies 802.11ax chipset support"
	depends on CPTCFG_MAC80211 && CPTCFG_CFG80211
	depends on BACKPORT_LINUX
	select CPTCFG_ATH_COMMON
	help
	  This module adds support for Qualcomm Technologies 802.11ax family of
	  chipsets.

	  Supported chipsets:
	  - QCA6390 (WiFi 6, PCIe)
	  - QCA6490 (WiFi 6E, PCIe)
	  - QCA6750 (WiFi 6, integrated)
	  - WCN7850 (WiFi 6E, PCIe)

	  If you choose to build a module, it'll be called ath11k.

config CPTCFG_ATH11K_DEBUG
	bool "QCA ath11k debugging"
	depends on CPTCFG_ATH11K
	help
	  Enables debug support

	  If unsure, say Y to make it easier to debug problems.

config CPTCFG_ATH11K_DEBUGFS
	bool "QCA ath11k debugfs support"
	depends on CPTCFG_ATH11K && DEBUG_FS
	help
	  Enable ath11k debugfs support

	  If unsure, say Y to make it easier to debug problems.

config CPTCFG_ATH11K_TRACING
	bool "QCA ath11k tracing support"
	depends on CPTCFG_ATH11K
	depends on EVENT_TRACING
	help
	  Select this to use ath11k tracing infrastructure.

config CPTCFG_ATH11K_SPECTRAL
	bool "QCA ath11k spectral scan support"
	depends on CPTCFG_ATH11K_DEBUGFS
	depends on RELAY
	help
	  Enable ath11k spectral scan support

	  Say Y to enable access to the FFT/spectral data via debugfs.

config CPTCFG_ATH11K_PCI
	tristate "Atheros ath11k PCI support"
	depends on CPTCFG_ATH11K
	depends on PCI
	help
	  This module adds support for PCIE bus

	  Supported chipsets:
	  - QCA6390 (WiFi 6, PCIe)
	  - QCA6490 (WiFi 6E, PCIe)
	  - WCN7850 (WiFi 6E, PCIe)

	  Requires CNSS2 platform driver.

config CPTCFG_ATH11K_AHB
	tristate "Atheros ath11k AHB support"
	depends on CPTCFG_ATH11K
	help
	  This module adds support for AHB bus

	  Supported chipsets:
	  - QCA6750 (WiFi 6, integrated/AHB)
	  - IPQ8074 (WiFi 6, integrated/AHB)
	  - IPQ6018 (WiFi 6, integrated/AHB)

	  Requires ICNSS2 platform driver.

config CPTCFG_ATH11K_SNOC
	tristate "Atheros ath11k SNOC support (Deprecated)"
	depends on CPTCFG_ATH11K
	help
	  This module adds support for SNOC bus (System NoC)

	  This is deprecated and most platforms should use AHB instead.
```

## backports/drivers/usb/class/Kconfig
```kconfig
# USB class drivers configuration
# This will be populated by gentree.py from upstream kernel

comment "USB class drivers"
	depends on BACKPORT_LINUX && USB

config CPTCFG_USB_WDM
	tristate "USB Wireless Device Management support"
	depends on BACKPORT_LINUX
	depends on USB
	select BACKPORT_COMPAT
	help
	  This driver supports the WMC Device Management functionality
	  of cell phones compliant to the CDC WMC specification. You can use
	  AT commands over this device.

	  To compile this driver as a module, choose M here: the
	  module will be called cdc-wdm.
```

## backports/net/mac80211/Kconfig
```kconfig
# mac80211 configuration
# This will be populated by gentree.py from upstream kernel

config CPTCFG_MAC80211
	tristate "Generic IEEE 802.11 Networking Stack (mac80211)"
	depends on BACKPORT_LINUX
	depends on CPTCFG_CFG80211
	select BACKPORT_COMPAT
	select CRYPTO
	select CRYPTO_ARC4
	select CRYPTO_AES
	select CRYPTO_CCM
	select CRYPTO_GCM
	select CRYPTO_CMAC
	select CRC32
	help
	  This option enables the hardware independent IEEE 802.11
	  networking stack. This is backported from Linux v5.10.

if CPTCFG_MAC80211

config CPTCFG_MAC80211_HAS_RC
	bool
	default y

config CPTCFG_MAC80211_RC_MINSTREL
	bool "Minstrel" if EXPERT
	default y
	help
	  This option enables the 'minstrel' TX rate control algorithm

choice
	prompt "Default rate control algorithm"
	depends on CPTCFG_MAC80211_HAS_RC
	default CPTCFG_MAC80211_RC_DEFAULT_MINSTREL
	help
	  This option selects the default rate control algorithm
	  to be used with mac80211. If unsure, select Minstrel.

config CPTCFG_MAC80211_RC_DEFAULT_MINSTREL
	bool "Minstrel"
	depends on CPTCFG_MAC80211_RC_MINSTREL
	help
	  Select Minstrel as the default rate control algorithm.

endchoice

config CPTCFG_MAC80211_RC_DEFAULT
	string
	default "minstrel_ht" if CPTCFG_MAC80211_RC_DEFAULT_MINSTREL
	default ""

config CPTCFG_MAC80211_MESH
	bool "Enable mac80211 mesh networking support"
	depends on CPTCFG_MAC80211
	help
	  Select this option to enable 802.11 mesh operation in mac80211
	  drivers that support it. 802.11 mesh networks allow devices to
	  communicate directly with each other without requiring a central
	  access point.

config CPTCFG_MAC80211_LEDS
	bool "Enable LED triggers"
	depends on CPTCFG_MAC80211
	depends on LEDS_CLASS
	select LEDS_TRIGGERS
	help
	  This option enables a few LED triggers for different
	  packet receive/transmit events.

config CPTCFG_MAC80211_DEBUGFS
	bool "Export mac80211 internals in DebugFS"
	depends on CPTCFG_MAC80211
	depends on DEBUG_FS
	help
	  Select this to see extensive information about
	  the internal state of mac80211 in debugfs.

config CPTCFG_MAC80211_MESSAGE_TRACING
	bool "Trace all mac80211 debug messages"
	depends on CPTCFG_MAC80211
	help
	  Select this option to have mac80211 register the
	  mac80211_msg trace subsystem with tracepoint debugging
	  messages on the tracepoint debugging framework. It will
	  increase the size of the kernel accordingly.

config CPTCFG_MAC80211_DEBUG_MENU
	bool "Select mac80211 debugging features"
	depends on CPTCFG_MAC80211
	help
	  This option collects various mac80211 debug settings.

config CPTCFG_MAC80211_NOINLINE
	bool "Do not inline TX/RX handlers"
	depends on CPTCFG_MAC80211_DEBUG_MENU
	help
	  This option affects code generation in mac80211, when
	  selected some functions are marked "noinline" to allow
	  easier debugging of problems in the transmit and receive
	  paths.

config CPTCFG_MAC80211_VERBOSE_DEBUG
	bool "Verbose debugging output"
	depends on CPTCFG_MAC80211_DEBUG_MENU
	help
	  Selecting this option causes mac80211 to print out
	  many debugging messages. It should not be selected
	  on production systems as some of the messages are
	  remotely triggerable.

endif # CPTCFG_MAC80211
```
